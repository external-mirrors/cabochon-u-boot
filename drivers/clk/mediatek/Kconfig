## drivers/clk/mediatek/Kconfig
```kconfig
if ARCH_MEDIATEK || ARCH_COREBOOT

config CLK_MTK
	bool
	depends on CLK && DM_RESET && POWER_DOMAIN
	def_bool n

menu "MediaTek clock drivers"

config CLK_MTK_MT7622
	bool "MediaTek MT7622 Clock Controller"
	select CLK_MTK
	default y if CONFIG_TARGET_MT7622
	help
	Say Y here to enable support for the clock controller
	on the MediaTek MT7622 SoC.

config CLK_MTK_MT7623
	bool "MediaTek MT7623 Clock Controller"
	select CLK_MTK
	default y if CONFIG_TARGET_MT7623
	help
	Say Y here to enable support for the clock controller
	on the MediaTek MT7623 SoC.

config CLK_MTK_MT7629
	bool "MediaTek MT7629 Clock Controller"
	select CLK_MTK
	default y if CONFIG_TARGET_MT7629
	help
	Say Y here to enable support for the clock controller
	on the MediaTek MT7629 SoC.

config CLK_MTK_MT7986
	bool "MediaTek MT7986 Clock Controller"
	select CLK_MTK
	default y if CONFIG_TARGET_MT7986
	help
	Say Y here to enable support for the clock controller
	on the MediaTek MT7986 SoC.

config CLK_MTK_MT7981
	bool "MediaTek MT7981 Clock Controller"
	select CLK_MTK
	default y if CONFIG_TARGET_MT7981
	help
	Say Y here to enable support for the clock controller
	on the MediaTek MT7981 SoC.

config CLK_MTK_MT7988
	bool "MediaTek MT7988 Clock Controller"
	select CLK_MTK
	default y if CONFIG_TARGET_MT7988
	help
	Say Y here to enable support for the clock controller
	on the MediaTek MT7988 SoC.

config CLK_MTK_MT7987
	bool "MediaTek MT7987 Clock Controller"
	select CLK_MTK
	default y if CONFIG_TARGET_MT7987
	help
	Say Y here to enable support for the clock controller
	on the MediaTek MT7987 SoC.

config CLK_MTK_MT8183
	bool "MediaTek MT8183 Clock Controller"
	select CLK_MTK
	default y if CONFIG_TARGET_MT8183 || ARCH_COREBOOT
	help
	Say Y here to enable support for the clock controller
	on the MediaTek MT8183 SoC.

config CLK_MTK_MT8186
	bool "MediaTek MT8186 Clock Controller"
	select CLK_MTK
	default y if ARCH_COREBOOT
	help
	Say Y here to enable support for the clock controller
	on the MediaTek MT8186 SoC.

config CLK_MTK_MT8188
	bool "MediaTek MT8188 GCC"
	select CLK_MTK
	default y if CONFIG_TARGET_MT8188
	help
	Say Y here to enable support for the Global Clock Controller
	on the MediaTek MT8188 SoC. This driver supports the clocks
	and resets exposed by the GCC hardware block.

config CLK_MTK_MT8192
	bool "MediaTek MT8192 Clock Controller"
	select CLK_MTK
	default y if ARCH_COREBOOT
	help
	Say Y here to enable support for the clock controller
	on the MediaTek MT8192 SoC.

config CLK_MTK_MT8195
	bool "MediaTek MT8195 Clock Controller"
	select CLK_MTK
	default y if ARCH_COREBOOT
	help
	Say Y here to enable support for the clock controller
	on the MediaTek MT8195 SoC.

config CLK_MTK_MT8365
	bool "MediaTek MT8365 Clock Controller"
	select CLK_MTK
	default y if CONFIG_TARGET_MT8365
	help
	Say Y here to enable support for the clock controller
	on the MediaTek MT8365 SoC.

config CLK_MTK_MT8512
	bool "MediaTek MT8512 Clock Controller"
	select CLK_MTK
	default y if CONFIG_TARGET_MT8512
	help
	Say Y here to enable support for the clock controller
	on the MediaTek MT8512 SoC.

config CLK_MTK_MT8516
	bool "MediaTek MT8516 Clock Controller"
select CLK_MTK
	default y if CONFIG_TARGET_MT8516
	help
	Say Y here to enable support for the clock controller
	on the MediaTek MT8516 SoC.

config CLK_MTK_MT8518
	bool "MediaTek MT8518 Clock Controller"
	select CLK_MTK
	default y if CONFIG_TARGET_MT8518
	help
	Say Y here to enable support for the clock controller
	on the MediaTek MT8518 SoC.

endmenu
endif
```
